## main/Kconfig.projbuild
```kconfig
menu "Brigaid FieldTest Conf"

    config FIELDTEST_TYPE
        int "Brigaid Fieldtest Type"
        default 0
        help
            Field Test Type for the example to use. Demo Type: 0 = WiFi SoftAP, 1 = WiFi Station, 2 = BLE Beacon, 3 = BLE Scanner

    config ESP_WIFI_SSID
        string "WiFi SSID"
        default "BrigaidNet"
        help
            SSID (network name) for the example to connect to.

    config ESP_WIFI_PASSWORD
        string "WiFi Password"
        default "brigaidnet"
        help
            WiFi password (WPA or WPA2) for the example to use.
    config ESP_WIFI_CHANNEL
        int "WiFi Channel"
        range 1 13
        default 1
        help
            WiFi channel (network channel) for the example to use.

    config ESP_MAX_STA_CONN
        int "Maximal STA connections"
        default 4
        help
            Max number of the STA connects to AP.
endmenu
```
